# file: semaphore.ioc
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Mcu.Family=STM32F4
Mcu.Name=STM32F405RGTx
Mcu.Package=LQFP64
NVIC.PriorityGroup=NVIC_PRIORITYGROUP_4
ProjectManager.HeapSize=0x200
ProjectManager.StackSize=0x400
ProjectManager.TargetToolchain=STM32CubeIDE
RCC.AHBFreq_Value=16000000
RCC.APB1Freq_Value=16000000
RCC.APB2Freq_Value=16000000
RCC.CortexFreq_Value=16000000
RCC.HSE_VALUE=25000000
RCC.HSI_VALUE=16000000
RCC.LSE_VALUE=32768
RCC.SYSCLKFreq_VALUE=16000000
RCC.VCOOutputFreq_Value=192000000
board=custom

// file: Core/Src/main.c
/* USER CODE BEGIN Header */
/**
  ******************************************************************************
  * @file           : main.c
  * @brief          : Main program body
  ******************************************************************************
  * @attention
  *
  * Copyright (c) 2025 STMicroelectronics.
  * All rights reserved.
  *
  * This software is licensed under terms that can be found in the LICENSE file
  * in the root directory of this software component.
  * If no LICENSE file comes with this software, it is provided AS-IS.
  *
  *include third party liberary on project,and in third party property add prop
  *
  ******************************************************************************
  */
/* USER CODE END Header */
#include "main.h"

/* USER CODE BEGIN Includes */
#include "FreeRTOS.h"
#include "task.h"
#include "semphr.h"
#include "queue.h"
#include "stdlib.h"
/* USER CODE END Includes */

/* USER CODE BEGIN PV */
TaskHandle_t manager;
TaskHandle_t employee;
SemaphoreHandle_t xWork;
QueueHandle_t xWorkQueue;
uint32_t emp_work, man, emp, xWorkTicketId;
/* USER CODE END PV */

void SystemClock_Config(void);

/* USER CODE BEGIN 0 */
void EmployeeDoWork(unsigned char TicketId)
{
	emp_work=TicketId;
	vTaskDelay(TicketId);
}
static void vEmployeeTask(void *pvParameters)
{
	uint32_t xWorkTicketId;
	portBASE_TYPE xStatus;
	while(1)
	{
		xSemaphoreTake(xWork,0);
		xStatus=xQueueReceive(xWorkQueue,&xWorkTicketId,0);
		if(xStatus==pdPASS)
		{
			emp=1;
			EmployeeDoWork(xWorkTicketId);
		}
		else
			emp=0;
	}
	}
void vManagerTask(void *pvParameters)
{
	portBASE_TYPE xStatus;
	while(1)
	{
		xWorkTicketId= (rand() & 0xFF);
		xStatus=xQueueSend(xWorkQueue,&xWorkTicketId,portMAX_DELAY);
		if(xStatus!=pdPASS)
			man=0;
		else
		{
			man=1;
			xSemaphoreGive(xWork);
			taskYIELD();
		}
	}
}
/* USER CODE END 0 */

int main(void)
{
  /* USER CODE BEGIN 1 */
	BaseType_t status1;
	BaseType_t status2;
  /* USER CODE END 1 */

  /* MCU Configuration--------------------------------------------------------*/

  /* Reset of all peripherals, Initializes the Flash interface and the Systick. */
  HAL_Init();

  /* Configure the system clock */
  SystemClock_Config();

  /* Initialize all configured peripherals */
  /* USER CODE BEGIN 2 */
  vSemaphoreCreateBinary(xWork);
  xWorkQueue= xQueueCreate(2,sizeof(unsigned int));
  if((xWork!=NULL)&&(xWorkQueue!=NULL))
  {status1=xTaskCreate(vManagerTask,"Manager",500,NULL,3,&manager);
  configASSERT(status1==pdPASS);

  status2=xTaskCreate(vEmployeeTask,"Employee",500,NULL,2,&employee);
  configASSERT(status2==pdPASS);

  vTaskStartScheduler();
  	}
  /* USER CODE END 2 */

  /* Infinite loop */
  while (1)
  {

  }
}

void SystemClock_Config(void)
{
  RCC_OscInitTypeDef RCC_OscInitStruct = {0};
  RCC_ClkInitTypeDef RCC_ClkInitStruct = {0};

  /** Configure the main internal regulator output voltage
  */
  __HAL_RCC_PWR_CLK_ENABLE();
  __HAL_PWR_VOLTAGESCALING_CONFIG(PWR_REGULATOR_VOLTAGE_SCALE1);

  /** Initializes the RCC Oscillators according to the specified parameters
  * in the RCC_OscInitTypeDef structure.
  */
  RCC_OscInitStruct.OscillatorType = RCC_OSCILLATORTYPE_HSI;
  RCC_OscInitStruct.HSIState = RCC_HSI_ON;
  RCC_OscInitStruct.HSICalibrationValue = RCC_HSICALIBRATION_DEFAULT;
  RCC_OscInitStruct.PLL.PLLState = RCC_PLL_NONE;
  if (HAL_RCC_OscConfig(&RCC_OscInitStruct) != HAL_OK)
  {
    Error_Handler();
  }

  /** Initializes the CPU, AHB and APB buses clocks
  */
  RCC_ClkInitStruct.ClockType = RCC_CLOCKTYPE_HCLK|RCC_CLOCKTYPE_SYSCLK
                              |RCC_CLOCKTYPE_PCLK1|RCC_CLOCKTYPE_PCLK2;
  RCC_ClkInitStruct.SYSCLKSource = RCC_SYSCLKSOURCE_HSI;
  RCC_ClkInitStruct.AHBCLKDivider = RCC_SYSCLK_DIV1;
  RCC_ClkInitStruct.APB1CLKDivider = RCC_HCLK_DIV1;
  RCC_ClkInitStruct.APB2CLKDivider = RCC_HCLK_DIV1;

  if (HAL_RCC_ClockConfig(&RCC_ClkInitStruct, FLASH_LATENCY_0) != HAL_OK)
  {
    Error_Handler();
  }
}

void Error_Handler(void)
{
  __disable_irq();
  while (1)
  {
  }
}
