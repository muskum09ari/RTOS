# file: message_queue.ioc
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Mcu.Family=STM32F4
Mcu.Name=STM32F405RGTx
Mcu.Package=LQFP64
NVIC.PriorityGroup=NVIC_PRIORITYGROUP_4
ProjectManager.HeapSize=0x200
ProjectManager.StackSize=0x400
ProjectManager.TargetToolchain=STM32CubeIDE
RCC.AHBFreq_Value=16000000
RCC.APB1Freq_Value=16000000
RCC.APB2Freq_Value=16000000
RCC.CortexFreq_Value=16000000
RCC.HSE_VALUE=25000000
RCC.HSI_VALUE=16000000
RCC.LSE_VALUE=32768
RCC.SYSCLKFreq_VALUE=16000000
RCC.VCOOutputFreq_Value=192000000
board=custom

// file: Core/Src/main.c
/* USER CODE BEGIN Header */
/**
  ******************************************************************************
  * @file           : main.c
  * @brief          : Main program body
  ******************************************************************************
  * @attention
  *
  * Copyright (c) 2025 STMicroelectronics.
  * All rights reserved.
  *
  * This software is licensed under terms that can be found in the LICENSE file
  * in the root directory of this software component.
  * If no LICENSE file comes with this software, it is provided AS-IS.
  *
  ******************************************************************************
  */
/* USER CODE END Header */
#include "main.h"

/* USER CODE BEGIN Includes */
#include "FreeRTOS.h"
#include "task.h"
#include "queue.h"
/* USER CODE END Includes */

/* USER CODE BEGIN PV */
TaskHandle_t Sender1;
TaskHandle_t Sender2;
TaskHandle_t Receiver;
QueueHandle_t SimpleQueue;
uint32_t count,received_data,receive,send1,send2;
/* USER CODE END PV */

void SystemClock_Config(void);
/* USER CODE BEGIN PFP */
//static void Sender_Task1(void *parameters);
//static void Sender_Task2(void *parameters);
//static void Receiver_Task(void *parameters);
/* USER CODE END PFP */

/* USER CODE BEGIN 0 */
static void Sender_Task1(void *pvparameters)
{uint32_t data=222;
uint32_t TickDelay=pdMS_TO_TICKS(2000); //1000=tickrate, 1sec=1000tick
while(1)
{
	if(xQueueSend(SimpleQueue,&data,portMAX_DELAY)==pdPASS)
		send1=1;
	else
		send1=0;
	vTaskDelay(TickDelay);
}

}
static void Sender_Task2(void *pvparameters)
{uint32_t data=pvparameters;
uint32_t TickDelay=pdMS_TO_TICKS(2000); //1000=tickrate, 1sec=1000tick
while(1)
{
	if(xQueueSend(SimpleQueue,&data,portMAX_DELAY)==pdPASS)
		send2=1;
	else
		send2=0;
	vTaskDelay(TickDelay);
}

}
//static void Sender_Task2(void *pvparameters)
//{
//	uint32_t data=pvparameters;
//	uint32_t TickDelay=pdMS_TO_TICKS(2000);
//	while(1)
//	{
//		if(xQueueSend(SimpleQueue,&data,portMAX_DELAY)==pdPASS)
//		send2=1;
//		else
//		send2=0;
//		vTaskDelay(TickDelay);
//	}
//
//}
static void Receiver_Task(void *pvparameters)
{
received_data=0;
uint32_t TickDelay=pdMS_TO_TICKS(5000);

while(1)
{
	if(xQueueReceive(SimpleQueue,&received_data,portMAX_DELAY)!=pdTRUE)
		receive=0;
	else
		receive=1;
	vTaskDelay(TickDelay);
}

}
/* USER CODE END 0 */

int main(void)
{
  /* USER CODE BEGIN 1 */
  BaseType_t status1;
  BaseType_t status2;
  BaseType_t status3;

  /* USER CODE END 1 */

  /* MCU Configuration--------------------------------------------------------*/

  /* Reset of all peripherals, Initializes the Flash interface and the Systick. */
  HAL_Init();

  /* Configure the system clock */
  SystemClock_Config();

  /* Initialize all configured peripherals */
  /* USER CODE BEGIN 2 */
//create integer queue
  SimpleQueue=xQueueCreate(5,sizeof(int));
  if(SimpleQueue==0)
	  count=0;
  else
	  count=1;

  //task related
  status1=xTaskCreate(Sender_Task1,"HPT_SEND",128,NULL,2,&Sender1);
  configASSERT(status1==pdPASS);

  status2=xTaskCreate(Sender_Task2,"LPT_SEND",128,(void*)111,3,&Sender2);
  configASSERT(status2==pdPASS);

  status3=xTaskCreate(Receiver_Task,"Receive",128,NULL,4,&Receiver);
  configASSERT(status3==pdPASS);

  vTaskStartScheduler();
  /* USER CODE END 2 */

  /* Infinite loop */
  while (1)
  {

  }
}

void SystemClock_Config(void)
{
  RCC_OscInitTypeDef RCC_OscInitStruct = {0};
  RCC_ClkInitTypeDef RCC_ClkInitStruct = {0};

  /** Configure the main internal regulator output voltage
  */
  __HAL_RCC_PWR_CLK_ENABLE();
  __HAL_PWR_VOLTAGESCALING_CONFIG(PWR_REGULATOR_VOLTAGE_SCALE1);

  /** Initializes the RCC Oscillators according to the specified parameters
  * in the RCC_OscInitTypeDef structure.
  */
  RCC_OscInitStruct.OscillatorType = RCC_OSCILLATORTYPE_HSI;
  RCC_OscInitStruct.HSIState = RCC_HSI_ON;
  RCC_OscInitStruct.HSICalibrationValue = RCC_HSICALIBRATION_DEFAULT;
  RCC_OscInitStruct.PLL.PLLState = RCC_PLL_NONE;
  if (HAL_RCC_OscConfig(&RCC_OscInitStruct) != HAL_OK)
  {
    Error_Handler();
  }

  /** Initializes the CPU, AHB and APB buses clocks
  */
  RCC_ClkInitStruct.ClockType = RCC_CLOCKTYPE_HCLK|RCC_CLOCKTYPE_SYSCLK
                              |RCC_CLOCKTYPE_PCLK1|RCC_CLOCKTYPE_PCLK2;
  RCC_ClkInitStruct.SYSCLKSource = RCC_SYSCLKSOURCE_HSI;
  RCC_ClkInitStruct.AHBCLKDivider = RCC_SYSCLK_DIV1;
  RCC_ClkInitStruct.APB1CLKDivider = RCC_HCLK_DIV1;
  RCC_ClkInitStruct.APB2CLKDivider = RCC_HCLK_DIV1;

  if (HAL_RCC_ClockConfig(&RCC_ClkInitStruct, FLASH_LATENCY_0) != HAL_OK)
  {
    Error_Handler();
  }
}

void Error_Handler(void)
{
  __disable_irq();
  while (1)
  {
  }
}
